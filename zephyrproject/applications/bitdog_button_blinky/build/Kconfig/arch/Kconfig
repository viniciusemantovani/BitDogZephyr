## zephyrproject/applications/bitdog_button_blinky/build/Kconfig/arch/Kconfig
```kconfig
# Load Zephyr Arch Kconfig descriptions.
osource "/home/pininsu/Documents/BitDogZephyr/zephyrproject/zephyr/arch/rx/Kconfig"
osource "/home/pininsu/Documents/BitDogZephyr/zephyrproject/zephyr/arch/x86/Kconfig"
osource "/home/pininsu/Documents/BitDogZephyr/zephyrproject/zephyr/arch/xtensa/Kconfig"
osource "/home/pininsu/Documents/BitDogZephyr/zephyrproject/zephyr/arch/sparc/Kconfig"
osource "/home/pininsu/Documents/BitDogZephyr/zephyrproject/zephyr/arch/riscv/Kconfig"
osource "/home/pininsu/Documents/BitDogZephyr/zephyrproject/zephyr/arch/posix/Kconfig"
osource "/home/pininsu/Documents/BitDogZephyr/zephyrproject/zephyr/arch/mips/Kconfig"
osource "/home/pininsu/Documents/BitDogZephyr/zephyrproject/zephyr/arch/arm64/Kconfig"
osource "/home/pininsu/Documents/BitDogZephyr/zephyrproject/zephyr/arch/arm/Kconfig"
osource "/home/pininsu/Documents/BitDogZephyr/zephyrproject/zephyr/arch/arc/Kconfig"
```

## zephyrproject/applications/bitdog_button_blinky/build/Kconfig/boards/Kconfig.defconfig
```kconfig
# Load Zephyr board defconfig descriptions.
osource "/home/pininsu/Documents/BitDogZephyr/zephyrproject/zephyr/boards/raspberrypi/rpi_pico/Kconfig.defconfig"
```

## zephyrproject/applications/bitdog_helloworld/build/Kconfig/boards/Kconfig
```kconfig
# Load Zephyr board Kconfig descriptions.
osource "/home/pininsu/Documents/BitDogZephyr/zephyrproject/zephyr/boards/raspberrypi/rpi_pico/Kconfig"
```
